/*************************************************************
**********************  Libraries ****************************
*************************************************************/
#include <ros.h>

#include <std_msgs/Int16.h>
#include <std_msgs/Float32.h>
#include <std_msgs/String.h>
#include <sensor_msgs/Temperature.h>
#include <sensor_msgs/RelativeHumidity.h>
#include <std_msgs/Bool.h>
#include <std_msgs/UInt8.h>
#include <stdio.h>
#include <Metro.h>

#include <rgb_matrix.h> // LED Matrix
#include <SPI.h>

/* Sensor libraries */
#include <DHT22.h>      // temperauture sensor
#include <MQ2.h> 
#include <MQ9.h>

/*************************************************************
 ********************* End of inclusion **********************
 ************************************************************/

/* ***********************************************************
 * ******************* declarations ************************** 
 *************************************************************/

/* ******************* LED Matrix ****************************/
#define N_X 2
#define N_Y 1

//Hardware SPI
#define DATA_PIN  51
#define CLK_PIN   52

#define LATCH_PIN 8

// variables 
rgb_matrix M = rgb_matrix(N_X, N_Y, DATA_PIN, CLK_PIN, LATCH_PIN);

Metro nextFrame = Metro(100);
Metro freezeFrame = Metro(5000);

int frameNumber = 0;

volatile int commandRcv;

const unsigned char normalFrames[5][16] =
{
  {0x00,0x00,0x00,0x00,0x00,0x00,0x00,0x00,0x00,0x00,0x00,0x00,0x00,0x00,0x00,0x00},
  {0x00,0x00,0x00,0x18,0x18,0x00,0x00,0x00,0x00,0x00,0x00,0x18,0x18,0x00,0x00,0x00},
  {0x00,0x00,0x3C,0x24,0x24,0x3C,0x00,0x00,0x00,0x00,0x3C,0x24,0x24,0x3C,0x00,0x00},
  {0x00,0x3C,0x66,0x42,0x42,0x66,0x3C,0x00,0x00,0x3C,0x66,0x42,0x42,0x66,0x3C,0x00},
  {0x7E,0xC3,0x81,0x81,0x81,0x81,0xC3,0x7E,0x7E,0xC3,0x81,0x81,0x81,0x81,0xC3,0x7E}
};//blue+green

const unsigned char angryFrames[14][16] =
{
  {0x7E,0xC3,0x81,0x81,0x81,0x81,0xC3,0x7E,0x7E,0xC3,0x81,0x81,0x81,0x81,0xC3,0x7E},
  {0x00,0x7E,0xC3,0x81,0x81,0xC3,0x7E,0x00,0x00,0x7E,0xC3,0x81,0x81,0xC3,0x7E,0x00},
  {0x00,0x00,0x7E,0x81,0x81,0x7E,0x00,0x00,0x00,0x00,0x7E,0x81,0x81,0x7E,0x00,0x00},
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  {0x00,0x00,0x00,0x18,0x18,0x00,0x00,0x00,0x00,0x00,0x00,0x18,0x18,0x00,0x00,0x00}
};//red

const unsigned char sadFrames[8][16] =
{
  {0x7E,0xC3,0x81,0x81,0x81,0x81,0xC3,0x7E,0x7E,0xC3,0x81,0x81,0x81,0x81,0xC3,0x7E},
  {0x3C,0x66,0x42,0x42,0x42,0x42,0x66,0x3C,0x3C,0x66,0x42,0x42,0x42,0x42,0x66,0x3C},
  {0x18,0x24,0x24,0x24,0x24,0x24,0x24,0x18,0x18,0x24,0x24,0x24,0x24,0x24,0x24,0x18},
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  {0x1E,0x07,0x03,0x03,0x03,0x03,0x07,0x1E,0x1E,0x07,0x03,0x03,0x03,0x03,0x07,0x1E}
};//red+blue

const unsigned char surprisedFrames[16][16] =
{
  {0x00,0x00,0x00,0x18,0x18,0x00,0x00,0x00,0x00,0x00,0x00,0x18,0x18,0x00,0x00,0x00},
  {0x00,0x00,0x3C,0x24,0x24,0x3C,0x00,0x00,0x00,0x00,0x3C,0x24,0x24,0x3C,0x00,0x00},
  {0x00,0x7E,0x42,0x42,0x42,0x42,0x7E,0x00,0x00,0x7E,0x42,0x42,0x42,0x42,0x7E,0x00},
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  {0xFF,0x81,0x81,0x81,0x81,0x81,0x81,0xFF,0xFF,0x81,0x81,0x81,0x81,0x81,0x81,0xFF}
};//red+green

const unsigned char fearfulFrames[13][16] =
{
  {0x7E,0xC3,0x81,0x81,0x81,0x81,0xC3,0x7E,0x7E,0xC3,0x81,0x81,0x81,0x81,0xC3,0x7E},
  {0x00,0x3C,0x66,0x42,0x42,0x66,0x3C,0x00,0x00,0x3C,0x66,0x42,0x42,0x66,0x3C,0x00},
  {0x00,0x00,0x3C,0x24,0x24,0x3C,0x00,0x00,0x00,0x00,0x3C,0x24,0x24,0x3C,0x00,0x00},
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  {0x7E,0xC3,0x81,0x99,0x99,0x81,0xC3,0x7E,0x7E,0xC3,0x81,0x99,0x99,0x81,0xC3,0x7E}
};//red+blue

const unsigned char restFrames[5][16] =
{
  {0x7E,0xC3,0x81,0x81,0x81,0x81,0xC3,0x7E,0x7E,0xC3,0x81,0x81,0x81,0x81,0xC3,0x7E},
  {0x3C,0x66,0x42,0x42,0x42,0x42,0x66,0x3C,0x3C,0x66,0x42,0x42,0x42,0x42,0x66,0x3C},
  {0x18,0x24,0x24,0x24,0x24,0x24,0x24,0x18,0x18,0x24,0x24,0x24,0x24,0x24,0x24,0x18},
  {0x18,0x18,0x18,0x18,0x18,0x18,0x18,0x18,0x18,0x18,0x18,0x18,0x18,0x18,0x18,0x18},
  {0x00,0x00,0x18,0x18,0x18,0x18,0x00,0x00,0x00,0x00,0x18,0x18,0x18,0x18,0x00,0x00}
};//blue+green

const unsigned char disgustedFrames[21][16] =
{
  {0x18,0x00,0x00,0x00,0x00,0x00,0x00,0x00,0x00,0x00,0x00,0x00,0x00,0x00,0x00,0x18},
  {0x3C,0x18,0x00,0x00,0x00,0x00,0x00,0x00,0x00,0x00,0x00,0x00,0x00,0x00,0x18,0x3C},
  {0x66,0x3C,0x18,0x00,0x00,0x00,0x00,0x00,0x00,0x00,0x00,0x00,0x00,0x18,0x3C,0x66},
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  {0x00,0x00,0x00,0x81,0xC3,0x66,0x3C,0x18,0x18,0x3C,0x66,0xC3,0x81,0x00,0x00,0x00}
};//red+green

const unsigned char happy1Frames[24][16] =
{
  {0x00,0x00,0x00,0x18,0x18,0x00,0x00,0x00,0x00,0x00,0x00,0x18,0x18,0x00,0x00,0x00},
  {0x00,0x00,0x00,0x18,0x18,0x00,0x00,0x00,0x00,0x00,0x00,0x18,0x18,0x00,0x00,0x00},
  {0x00,0x00,0x3C,0x3C,0x3C,0x3C,0x00,0x00,0x00,0x00,0x3C,0x3C,0x3C,0x3C,0x00,0x00},
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  {0x18,0x00,0x00,0x81,0x81,0x00,0x00,0x18,0x18,0x00,0x00,0x81,0x81,0x00,0x00,0x18}
};//Mixture...

const unsigned char happy2Frames[20][16] =
{
  {0x18,0x5A,0x3C,0xFF,0xFF,0x3C,0x5A,0x18,0x18,0x5A,0x3C,0xFF,0xFF,0x3C,0x5A,0x18},
  {0x34,0x14,0xFD,0x3F,0xFC,0xBF,0x28,0x2C,0x2C,0x28,0xBF,0xFC,0x3F,0xFD,0x14,0x34},
  {0x2C,0x28,0xBF,0xFC,0x3F,0xFD,0x14,0x34,0x34,0x14,0xFD,0x3F,0xFC,0xBF,0x28,0x2C},
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  {0x18,0x5A,0x3C,0xE7,0xE7,0x3C,0x5A,0x18,0x18,0x5A,0x3C,0xE7,0xE7,0x3C,0x5A,0x18}
};//Mixture...

/* ************  End of declarations for LED Matrix ****************/

/* ***********   Security Sensing **********************************/

/* MEGA 2560 Pin configurations */
#define DHT22_PIN    22    // DHT22 (temperture & humidity reading) digital input
#define PIR_PIN      23    // PIR (motion sensor) digital input
#define Flame_PIN    A0    // Flame sensor V2 analog input
#define MQ2_PIN      A1    // MQ2 (smoke sensor) analog input
#define MQ9_PIN_AI   A2    // MQ9 (smoke sensor) analog input
//#define MQ9_PIN_DI   24    // MQ9 (smoke sensor) diginal input
#define Dust_PIN_AI  A3    // Sharp Optical Dust sensor analog input
#define Dust_PIN_DO  25    // Sharp Optical Dust sensor diginal

/* Setup variables used in this code*/
DHT22 andbotDHT22(DHT22_PIN);
MQ2 andbotMQ2(MQ2_PIN);
MQ9 andbotMQ9(MQ9_PIN_AI);

long publisher_timer ;
Metro publishPeriod = Metro(2200); // sensor
Metro LEDMatrixPeriod = Metro(20); // LED Matrix 

sensor_msgs::Temperature DHT22_Temperature_msgs; // DHT22 -temperture digital input
sensor_msgs::RelativeHumidity DHT22_Humidity_msgs; // DHT22 -Humidity digital input
std_msgs::Bool PIR_msgs; //PIR (motion sensor) digital input
std_msgs::Float32 Flame_msgs; // Flame sensor V2 analog input
std_msgs::Float32 MQ2_msgs_LPG; // MQ2 (smoke sensor) analog input
std_msgs::Float32 MQ2_msgs_CO;
std_msgs::Float32 MQ2_msgs_SMOKE;
std_msgs::Float32 MQ9_msgs_CO; // MQ9 (smoke sensor) analog input
std_msgs::Float32 MQ9_msgs_LPG;
std_msgs::Float32 MQ9_msgs_CH4;
//std_msgs::Bool MQ9_msgs_DI; // MQ9 (smoke sensor) digital input
std_msgs::Float32 Dust_msgs; // Sharp Optical Dust sensor analog input
std_msgs::Float32 Dust_msgs_VoMeasured; // Sharp Optical Dust sensor analog input

/* temporary varibles for Dust sensing*/
float voMeasured = 0;
float calcVoltage = 0;
/* sampling timing of output pulse in Dust sensor (from Datasheet)*/
int samplingTime = 280; // LED Pulse Width = samplingTime + deltaTime = 320us
int deltaTime = 40;
int sleepTime = 9680; // period (per pulse) = 10ms, i.e, sleepingTime = 10ms - 320us = 9680 us

Metro warmup = Metro(2000) ; //(msec)
bool SensorReadyFlag = false;
/* ************  End of declarations for Security Sensing ****************/

/* ************  declarations for ROS usages *****************************************/

/*  define  ROS node and topics */
ros::NodeHandle metal_head;
ros::Publisher pub_DHT22Temp("/CurTemperature", &DHT22_Temperature_msgs);
ros::Publisher pub_DHT22Humid("/CurHumidity", &DHT22_Humidity_msgs);
ros::Publisher pub_PIRstate("/MotionDetection", &PIR_msgs);
ros::Publisher pub_Flame("/FlameDetection", &Flame_msgs);
ros::Publisher pub_MQ2LPG("/MQ2LPG", & MQ2_msgs_LPG);
ros::Publisher pub_MQ2CO("/MQ2CO", & MQ2_msgs_CO);
ros::Publisher pub_MQ2SMOKE("/MQ2SMOKE", & MQ2_msgs_SMOKE);
ros::Publisher pub_MQ9LPG("/MQ9LPG", & MQ9_msgs_LPG);
ros::Publisher pub_MQ9CO("/MQ9CO", & MQ9_msgs_CO);
ros::Publisher pub_MQ9CH4("/MQ9CH4", & MQ9_msgs_CH4);
ros::Publisher pub_Dust("/DustDetection", & Dust_msgs);
ros::Publisher pub_Dust_V("/DustDetectionV", & Dust_msgs_VoMeasured);

/* ************  End of declarations for ROS usages ****************/

/* functions start here */
void _expression( const std_msgs::UInt8& cmd_msg)
{
  M.set_cur(0,0);
  M.clear(); 
  commandRcv = (int) cmd_msg.data;
  frameNumber = 0;
  nextFrame.reset();
  freezeFrame.reset();
}

ros::Subscriber<std_msgs::UInt8> sub_eyes("/andbot/EyesLED", _expression);

void setup() {
  //initialize mega 2560 for sensor input
  pinMode(PIR_PIN, INPUT); //setup pin
  //pinMode(MQ9_PIN_DI, INPUT);
  pinMode(Dust_PIN_DO, OUTPUT);

  /* ROS Node configurations */
  metal_head.initNode();
  metal_head.advertise(pub_DHT22Temp);
  metal_head.advertise(pub_DHT22Humid);
  metal_head.advertise(pub_PIRstate);
  metal_head.advertise(pub_Flame);
  metal_head.advertise(pub_MQ2LPG);
  metal_head.advertise(pub_MQ2CO);
  metal_head.advertise(pub_MQ2SMOKE);
  metal_head.advertise(pub_MQ9LPG);
  metal_head.advertise(pub_MQ9CO);
  metal_head.advertise(pub_MQ9CH4);
  //metal_head.advertise(pub_MQ9Smoke_DI);
  metal_head.advertise(pub_Dust);
  metal_head.advertise(pub_Dust_V);

  //Serial.begin(115200);

  /* sensor calibration */
  andbotMQ2.MQCalibration();
  andbotMQ9.MQCalibration();

  /* LED */
  commandRcv = -1;
  metal_head.subscribe(sub_eyes);
  metal_head.spinOnce();
  M.set_cur(0,0);
  M.clear();  
  //M.display(hook);
}

void loop() {
  // put your main code here, to run repeatedly:

  //warmup sequence
  if (SensorReadyFlag == false)
  {
    if (warmup.check() == false)
    {
      SensorReadyFlag = false;
      Serial.println("Please wait ...");
        }
        else
    {
      SensorReadyFlag = true;
      Serial.println("warmup finish");
    }
  }
  else;

  /* DHT22 reading... */
  DHT22_ERROR_t errorCode;

  if (publishPeriod.check() == true && SensorReadyFlag == true)
  {
    errorCode = andbotDHT22.readData();
    switch (errorCode)
    {
      case DHT_ERROR_NONE:
        DHT22_Temperature_msgs.temperature = (double)andbotDHT22.getTemperatureC();
        DHT22_Humidity_msgs.relative_humidity = (double)andbotDHT22.getHumidity();
        pub_DHT22Temp.publish(&DHT22_Temperature_msgs);
        pub_DHT22Humid.publish(&DHT22_Humidity_msgs);
        break;
      case DHT_ERROR_CHECKSUM:
        Serial.println("sum error");
        break;
      case DHT_BUS_HUNG:
        Serial.println("BUS Hung");
        break;
      case DHT_ERROR_NOT_PRESENT:
        Serial.println("Nothing");
        break;
      case DHT_ERROR_ACK_TOO_LONG:
        Serial.println("ACK time out ");
        break;
      case DHT_ERROR_SYNC_TIMEOUT:
        Serial.println("Sync Timeout ");
        break;
      case DHT_ERROR_DATA_TIMEOUT:
        Serial.println("Data timeout");
        break;
      case DHT_ERROR_TOOQUICK:
        Serial.println("Polled to quick ");
        break;
      
    }

    /* motion detection */
    PIR_msgs.data = digitalRead(PIR_PIN);
    pub_PIRstate.publish(&PIR_msgs);

    if (PIR_msgs.data == true)
    {
      Serial.println("Somebody is in this area!");
    }
    else
    {
      Serial.println("No one!");
    }

    /* flame detection */
    Flame_msgs.data = analogRead(Flame_PIN);
    pub_Flame.publish(&Flame_msgs);

    /*Smoke detection MQ2 */
    MQ2_msgs_LPG.data = andbotMQ2.readLPG();// follow the recommendation regarding LPS on datasheet
    MQ2_msgs_CO.data = andbotMQ2.readCO();
    MQ2_msgs_SMOKE.data = andbotMQ2.readSMOKE();
    pub_MQ2LPG.publish(&MQ2_msgs_LPG);
    pub_MQ2CO.publish(&MQ2_msgs_CO);
    pub_MQ2SMOKE.publish(&MQ2_msgs_SMOKE);

    /* Smoke detection MQ9 */
    MQ9_msgs_LPG.data = andbotMQ9.readLPG();
    MQ9_msgs_CO.data = andbotMQ9.readCO();
    MQ9_msgs_CH4.data = andbotMQ9.readCH4();
    Serial.print("CH4: ");
    Serial.println(MQ9_msgs_CH4.data);
    //MQ9_msgs_DI.data = digitalRead(MQ9_PIN_DI);
    pub_MQ9LPG.publish(&MQ9_msgs_LPG);
    pub_MQ9CO.publish(&MQ9_msgs_CO);
    pub_MQ9CH4.publish(&MQ9_msgs_CH4);
    //pub_MQ9Smoke_DI.publish(&MQ9_msgs_DI);

    /* Dust detection */
    digitalWrite(Dust_PIN_DO, LOW); // power on the LED
    delayMicroseconds(samplingTime);

    voMeasured = analogRead(Dust_PIN_AI);

    delayMicroseconds(deltaTime);
    digitalWrite(Dust_PIN_DO, HIGH); // turn the LED off
    delayMicroseconds(sleepTime);

    calcVoltage = voMeasured * (5.0 / 1024.0); //restore volatage value
    Dust_msgs_VoMeasured.data = calcVoltage;
    pub_Dust_V.publish(&Dust_msgs_VoMeasured);

    //Dust_msgs.data = 0.17 * calcVoltage - 0.1; //linear eqaution taken from http://www.howmuchsnow.com/arduino/airquality/ ,Chris Nafis (c) 2012
    Dust_msgs.data = 0.2 * calcVoltage - 0.18; // this equation is appoximately calculated by using typical value shown in its datasheet
    pub_Dust.publish(&Dust_msgs);

    /* timer */
    //publisher_timer = millis() + publishPeriod;
  }
  else;
  metal_head.spinOnce();
  
  if (LEDMatrixPeriod.check() == true)
  {
    M.display(hook);
  }
  else;
}
void hook(void)
{
  //Serial.println("hook");
  switch (commandRcv)
  {
    case 0://normal
      if(nextFrame.check() == 1 && frameNumber<5)
      {
        for(int i = 0; i < 16; ++i){
          M.put_byte(i,0,normalFrames[frameNumber][i],COVER,6,TOP_LAYER);}
        if(frameNumber<5)frameNumber++;
      }
      if(freezeFrame.check() == 1) frameNumber = 0;
      break;
    case 2://happy1
      if(nextFrame.check() == 1 && frameNumber<24)
      {
        for(int i = 0; i < 16; ++i){
          M.put_byte(i,0,happy1Frames[frameNumber][i],COVER,7,TOP_LAYER);}
        if(frameNumber<24)frameNumber++;
      }
      if(freezeFrame.check() == 1) frameNumber = 0;
      break;
    case 3://happy2
      if(nextFrame.check() == 1 && frameNumber<20)
      {
        for(int i = 0; i < 16; ++i){
          M.put_byte(i,0,happy2Frames[frameNumber][i],COVER,7,TOP_LAYER);}
        if(frameNumber<20)frameNumber++;
      }
      if(freezeFrame.check() == 1) frameNumber = 0;
      break;
    case 5://surprised
      if(nextFrame.check() == 1 && frameNumber<16)
      {
        for(int i = 0; i < 16; ++i){
          M.put_byte(i,0,surprisedFrames[frameNumber][i],COVER,3,TOP_LAYER);}
        if(frameNumber<16)frameNumber++;
      }
      if(freezeFrame.check() == 1) frameNumber = 0;
      break;
    case 4://sad
      if(nextFrame.check() == 1 && frameNumber<8)
      {
        for(int i = 0; i < 16; ++i){
          M.put_byte(i,0,sadFrames[frameNumber][i],COVER,5,TOP_LAYER);}
        if(frameNumber<8)frameNumber++;
      }
      if(freezeFrame.check() == 1) frameNumber = 0;
      break;
    case 8://fearful
      if(nextFrame.check() == 1 && frameNumber<13)
      {
        for(int i = 0; i < 16; ++i){
          M.put_byte(i,0,fearfulFrames[frameNumber][i],COVER,5,TOP_LAYER);}
        if(frameNumber<13)frameNumber++;
      }
      if(freezeFrame.check() == 1) frameNumber = 0;
      break;
    case 6://angry
      if(nextFrame.check() == 1 && frameNumber<14)
      {
        for(int i = 0; i < 16; ++i){
          M.put_byte(i,0,angryFrames[frameNumber][i],COVER,1,TOP_LAYER);}
        if(frameNumber<14)frameNumber++;
      }
      if(freezeFrame.check() == 1) frameNumber = 0;
      break;
    case 7://disgusted
      if(nextFrame.check() == 1 && frameNumber<21)
      {
        for(int i = 0; i < 16; ++i){
          M.put_byte(i,0,disgustedFrames[frameNumber][i],COVER,3,TOP_LAYER);}
        if(frameNumber<21)frameNumber++;
      }
      if(freezeFrame.check() == 1) frameNumber = 0;
      break;
    case 1://rest
      if(nextFrame.check() == 1 && frameNumber<5)
      {
        for(int i = 0; i < 16; ++i){
          M.put_byte(i,0,restFrames[frameNumber][i],COVER,6,TOP_LAYER);}
        if(frameNumber<5)frameNumber++;
      }
      if(freezeFrame.check() == 1) frameNumber = 0;
      break;
    default:
      metal_head.spinOnce();
      break;
  }

  metal_head.spinOnce();
}
